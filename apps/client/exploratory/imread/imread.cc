// Copyright (c) 2023 Niantic, Inc.
// Original Author: Dat Chu (datchu@nianticlabs.com)
// Compare our image-io routine against PIL Image.open
// Usage
//   bazel run apps/client/exploratory/imread:imread -- $HOME/Downloads/0_orig.jpg $HOME/Downloads/0_orig.csv

#include "bzl/inliner/rules2.h"

cc_binary {
  name = "imread",
  data = {
  };
  deps = {
    "//c8/io:image-io",
    "//c8:c8-log",
  };
}
cc_end(0xe0a1ebcb);

#include "c8/io/image-io.h"
#include "c8/c8-log.h"
#include <fstream>
#include <string>

using namespace c8;
using std::string;
using std::fstream;

RGB888PlanePixelBuffer read3DArrayOnePerLine(const string& arrPath, int rows, int cols) {
  fstream arrFile(arrPath.c_str(), fstream::in);
  float fVal;

  RGB888PlanePixelBuffer pix = {rows, cols};
  for (size_t i = 0; i < pix.pixels().rows(); i++) {
    uint8_t *data = pix.pixels().pixels() + i * pix.pixels().rowBytes();
    for (size_t j = 0; j < pix.pixels().cols(); j++) {
        arrFile >> fVal;
        data[j * 3 + 0] = fVal;
        arrFile >> fVal;
        data[j * 3 + 1] = fVal;
        arrFile >> fVal;
        data[j * 3 + 2] = fVal;
    }
  }
  return pix;
}

int main(int argc, char *argv[]) {
  string imagePath = {argv[1]};
  string arrPath = {argv[2]};
  C8Log("[imread] Reading image %s", imagePath.c_str());
  RGB888PlanePixelBuffer imgBuf = readJpgToRGB(imagePath);
  C8Log("[imread] Image size width=%d height=%d", imgBuf.pixels().cols(), imgBuf.pixels().rows());

  /* Generated by reading imagePath

  from PIL import Image
  import numpy as np

  orig_img = np.array(Image.open('./0_orig.jpg'))
  np.savetxt('./0_orig.csv', orig_img, delimiter=",")

    Expected shape is (720, 540, 3)
  */

  C8Log("[imread] Reading array %s", arrPath.c_str());
  RGB888PlanePixelBuffer arrBuf = read3DArrayOnePerLine(arrPath, 720, 540);

  C8Log("[imread] Comparing image diff");
  for (size_t i = 0; i < arrBuf.pixels().rows(); i++) {
    uint8_t *arrData = arrBuf.pixels().pixels() + i * arrBuf.pixels().rowBytes();
    uint8_t *imgData = imgBuf.pixels().pixels() + i * imgBuf.pixels().rowBytes();
    for (size_t j = 0; j < arrBuf.pixels().cols(); j++) {
      bool isREqual = arrData[j * 3 + 0] == imgData[j * 3 + 0];
      bool isGEqual = arrData[j * 3 + 1] == imgData[j * 3 + 1];
      bool isBEqual = arrData[j * 3 + 2] == imgData[j * 3 + 2];
      if (!isREqual) {
        C8Log("[imread] Red arr = %u, Red img = %u", arrData[j * 3 + 0], imgData[j * 3 + 0]);
      }
      if (!isGEqual) {
        C8Log("[imread] Green arr = %u, Green img = %u", arrData[j * 3 + 1], imgData[j * 3 + 1]);
      }
      if (!isBEqual) {
        C8Log("[imread] Blue arr = %u, Blue img = %u", arrData[j * 3 + 2], imgData[j * 3 + 2]);
      }
      if (!isREqual || !isGEqual || !isBEqual) {
        C8Log("[imread] %d row %d cols has a different value", i, j);
        return 1;
      }
    }
  }
  C8Log("[imread] Comparing image diff done. Found no diff.");

  return 0;
}
